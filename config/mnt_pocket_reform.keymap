// Copyright 2023 Manna Harbour
// https://github.com/manna-harbour/miryoku

#include "../miryoku/custom_config.h"
#include "../miryoku/mapping/60/preonic.h"

#undef MIRYOKU_MAPPING
#define MIRYOKU_MAPPING(...) MIRYOKU_LAYOUTMAPPING_PREONIC(__VA_ARGS__) \
XXX  XXX  XXX  XXX  U_BTN1  XXX  XXX  U_BTN2  U_BTN3  XXX  XXX  XXX

#include "../miryoku/miryoku.dtsi"

/ {
  combos {
    compatible = "zmk,combos";

    combo_btn3 {
      bindings = <U_BTN3>;
      key-positions = <64 67>;
    };
  };
};

#undef U_BOOT
#define U_BOOT &u_sp_toggle
MIRYOKU_DOUBLE_TAP_GUARD(u_sp_toggle, &sp_toggle)
