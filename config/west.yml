## config/west.yml
```yaml
manifest:
  remotes:
    - name: zmkfirmware
      url-base: https://github.com/zmkfirmware/
    - name: petejohanson
      url-base: https://github.com/petejohanson/
    - name: jablko
      url-base: https://github.com/jablko/
  projects:
    - name: zmk
      remote: zmkfirmware
      revision: 34c8b3f1e30725d2711d5a75cd2da8e60da7b995
      import: app/west.yml
    - name: revxlp-config
      remote: petejohanson
      revision: HEAD
    - name: pocket-reform-zmk-config
      remote: jablko
      revision: HEAD
  self:
    path: config/
```
